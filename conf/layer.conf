## conf/layer.conf
```bitbake
# We have a conf and classes directory, add to BBPATH
BBPATH .= ":${LAYERDIR}"

# We have recipes-* directories, add to BBFILES
BBFILES += "${LAYERDIR}/recipes-*/*/*.bb \
            ${LAYERDIR}/recipes-*/*/*.bbappend"

BBFILE_COLLECTIONS += "meta-gotzl"
BBFILE_PATTERN_meta-gotzl = "^${LAYERDIR}/"
BBFILE_PRIORITY_meta-gotzl = "10"

LAYERDEPENDS_meta-gotzl = "core"
LAYERSERIES_COMPAT_meta-gotzl = "zeus dunfell"
```
